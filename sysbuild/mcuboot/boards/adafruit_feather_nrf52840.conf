## sysbuild/mcuboot/boards/adafruit_feather_nrf52840.conf
```kconfig
# Copyright (c) 2024 Golioth, Inc.
# SPDX-License-Identifier: Apache-2.0

CONFIG_MAIN_STACK_SIZE=10240

# Enable flash operations
CONFIG_FLASH=y

# This must be increased to accommodate the bigger images.
CONFIG_BOOT_MAX_IMG_SECTORS=256
```

## sysbuild/mcuboot/boards/nrf52840dk_nrf52840.conf
```kconfig
#
# Copyright (c) 2021 Nordic Semiconductor ASA
#
# SPDX-License-Identifier: LicenseRef-Nordic-5-Clause
#

# In order to provide board specific configurations to the MCUboot child image
# we also need to provide a base configuration for MCUboot. This file contains
# the basic configurations needed to successfully build and run MCUboot.

# MCUboot requires a large stack size, otherwise an MPU fault will occur
#CONFIG_MAIN_STACK_SIZE=10240

# Enable flash operations
#CONFIG_FLASH=y

# This must be increased to accommodate the bigger images.
#CONFIG_BOOT_MAX_IMG_SECTORS=256

# Enable serial recovery
#CONFIG_UART_CONSOLE=n
#CONFIG_MCUBOOT_SERIAL=y
#CONFIG_MCUBOOT_SERIAL_DIRECT_IMAGE_UPLOAD=y

#CONFIG_PM_EXTERNAL_FLASH_MCUBOOT_SECONDARY=y

CONFIG_NORDIC_QSPI_NOR=y
CONFIG_NORDIC_QSPI_NOR_FLASH_LAYOUT_PAGE_SIZE=4096
CONFIG_NORDIC_QSPI_NOR_STACK_WRITE_BUFFER_SIZE=16
```
